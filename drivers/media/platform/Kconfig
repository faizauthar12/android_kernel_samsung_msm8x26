## drivers/media/platform/Kconfig
```kconfig
source "drivers/media/platform/msm/Kconfig"
source "drivers/platform/samsung/Kconfig"
```

## drivers/platform/samsung/Kconfig
```kconfig
# Samsung configuration options

config MACH_SAMSUNG
	bool "SAMSUNG device"
	depends on ARCH_MSM
	help
	  Support for Samsung products

config MACH_SAMSUNG_MSM8x26
	bool "SAMSUNG MSM8x26"
	depends on ARCH_MSM
	select MACH_SAMSUNG
	help
	  Support for MSM8x26 Samsung variants

menu "Samsung board selection"

	config MACH_SAMSUNG_MS01xx
		bool "SAMSUNG MS01xx board"
		select MACH_SAMSUNG_MSM8x26
		help
		  Support for Samsung Galaxy Grand 2 variant

endmenu
```

## drivers/sensors/Kconfig
```kconfig
config SENSORS
	bool "Sensors Class Support"
	help
	  This option enables the sensor sysfs class in /sys/class/sensors.
	  You'll need this to do anything useful with sensorss. If unsure, say N.

config SENSORS_GP2A030A
	depends on I2C
	tristate "GP2A030A Light Driver"
	default n
	help
	  Say Y here if you use GP2A030A.
	  This option enables optial sensors using
	  Sharp GP2A030A device driver.

	  Say N here if you do not use GP2A030A.

config SENSORS_GP2A030A_PROX
	depends on SENSORS_GP2A030A
	tristate "GP2A030A Proximity Driver"
	default n
	help
	  Say Y here if you use GP2A030A.
	  This option enables optial sensors using
	  Sharp GP2A030A device driver.

	  Say N here if you do not use GP2A030A.
```
